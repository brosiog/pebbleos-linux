## subsys/samsa/Kconfig
```kconfig
# SPDX-FileCopyrightText: 2026 Core Devices LLC
# SPDX-License-Identifier: Apache-2.0

config SAMSA
    bool "Run third-party apps with the Samsa Thumb-2 interpreter"
    depends on !CPU_CORTEX_M
    default y if SOC_POSIX
    # The thunks are generated from the SDK built for apps.
    select REQUIRES_ARM_TOOLCHAIN
    help
      Interpret the ARM code of third-party apps and workers with Samsa,
      so a native build can install and run .pbw files.

if SAMSA

config SAMSA_NATIVE_ARM
    bool "Execute Pebble apps directly on an ARM Linux host"
    depends on LINUX_WATCH
    default n
    help
      Experimental 32-bit soft-float ARM host using the Pebble app ABI.
      Requires an ARMv7-compatible CPU and executable application RAM.

config SAMSA_CACHE_ENTRIES
    int "Predecoded instruction cache entries"
    range 0 1024
    default 0
    help
      Zero disables caching. Otherwise use a power of two up to 1024.
      Each process uses about 12 bytes per entry.

module = SAMSA
module-str = Samsa
source "subsys/logging/Kconfig.template.log_level"

endif
```
